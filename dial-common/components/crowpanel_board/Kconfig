## dial-common/components/crowpanel_board/Kconfig
```kconfig
menu "CrowPanel 1.28in board"

comment "Display"

config CROWPANEL_LCD_BGR
    bool "Panel expects BGR element order"
    default y
    help
      Swaps red and blue. y is VERIFIED on hardware (TrailCurrent Capstan),
      against a deliberate red/green/blue test pattern rather than a screen
      of UI chrome, which will not show a red/blue swap.

      Do not derive this from the vendor's LovyanGFX `cfg.rgb_order`
      (false on this board). It does not map onto esp_lcd's element order
      the way the name suggests -- deriving it from there gave the wrong
      colours.

config CROWPANEL_LCD_MIRROR_X
    bool "Mirror the display horizontally"
    default y
    help
      y is VERIFIED on hardware: text reads backwards without it.

config CROWPANEL_LCD_MIRROR_Y
    bool "Mirror the display vertically"
    default n
    help
      n is VERIFIED on hardware. To turn the picture upside down, set
      CROWPANEL_ROTATE_180 rather than changing the mirrors.

config CROWPANEL_ROTATE_180
    bool "Module is mounted rotated 180 degrees"
    default n
    help
      Turns the picture upside down and moves the LED ring's angles round by
      180 degrees, so the face reads upright and ring patterns still point
      where the head unit drew them. Rotation needs nothing: turning the
      module in its own plane keeps clockwise clockwise.

comment "Rotary ring"

config CROWPANEL_ENCODER_STEPS_PER_DETENT
    int "Quadrature counts per detent"
    range 1 8
    default 4
    help
      Counts the 4x quadrature decoder produces per mechanical detent.
      VERIFIED on hardware: 4. The EC3501 datasheet's "1 pulse per 2
      detents" would give 2, and at 2 every felt click moves by two -- its
      own section 4-2 (30 pulses per revolution per phase) is the one the
      board agrees with. Enable CROWPANEL_ENCODER_DEBUG and turn one detent
      to measure a different unit.

config CROWPANEL_ENCODER_INVERT
    bool "Invert rotation direction"
    default n
    help
      Clockwise must increase. VERIFIED on hardware: this board counts the
      right way round without inverting.

config CROWPANEL_ENCODER_DEBUG
    bool "Log raw encoder counts"
    default n

comment "LED ring"

config CROWPANEL_LEDS_MAX_BRIGHTNESS
    int "Maximum LED ring brightness (percent)"
    range 1 100
    default 100
    help
      Ceiling applied to every LED write, on top of the brightness the head
      unit already applies. 100 is full scale.

endmenu
```

## dial-common/components/godwit_dial/Kconfig
```kconfig
menu "Godwit dial"

choice GODWIT_DIAL_SIDE
    prompt "Which dial this firmware is for"
    default GODWIT_DIAL_SIDE_LEFT
    help
      Set by the dial-left and dial-right projects in their
      sdkconfig.defaults. The head unit reads it from the dial's
      DIAL_FEATURE_INFO report to tell the two apart, and it is in the USB
      product name ("Godwit Dial Left" / "Godwit Dial Right").

config GODWIT_DIAL_SIDE_LEFT
    bool "Left"

config GODWIT_DIAL_SIDE_RIGHT
    bool "Right"

endchoice

config GODWIT_DIAL_HOST_TIMEOUT_MS
    int "Standby after this long without a ring frame (ms)"
    range 200 10000
    default 1500
    help
      The head unit sends ~30 ring frames a second. When none arrives for
      this long the dial shows its own standby face until they resume.

endmenu
```

## os/meta-dragon-q6a/conf/layer.conf
```bitbake
BBPATH .= ":${LAYERDIR}"

BBFILES += "${LAYERDIR}/recipes-*/*/*.bb \
            ${LAYERDIR}/recipes-*/*/*.bbappend"

BBFILE_COLLECTIONS += "dragon-q6a"
BBFILE_PATTERN_dragon-q6a = "^${LAYERDIR}/"
BBFILE_PRIORITY_dragon-q6a = "10"

LAYERDEPENDS_dragon-q6a = "core"
LAYERSERIES_COMPAT_dragon-q6a = "wrynose"
```
